## drivers/input/fpc1020/Kconfig
```kconfig
config INPUT_FPC1020
	tristate "fpc1020 driver support"
	depends on SPI && INPUT
	help
	  Say Y here if you want to support fpc1020 etc...
```

## drivers/usb/misc/anx7418/Kconfig
```kconfig
config ANALOGIX_OHIO
	tristate "Analogix Type-C interface support"
	depends on VENDOR_LEECO
	default y
	help
	  The Analogix ANX7418 is the Type-C port controller on the LeEco x2
	  evt and dvt1 boards, advertised as "analogix,ohio".  It handles CC
	  detection and hands the port over to the DisplayPort and MHL path.
```
